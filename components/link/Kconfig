## components/link/Kconfig
```kconfig
menu "Mock radio: two-board link"

    choice MOCK_LINK
        prompt "How audio travels between two boards"
        default MOCK_LINK_ESPNOW
        help
            The link route makes two mock radios hear each other: what one
            host transmits, the other receives. This chooses what carries
            the audio between the boards. It is a build-time choice, and
            both boards need the same one.

        config MOCK_LINK_ESPNOW
            bool "ESP-NOW (no wires; shares the 2.4 GHz radio with Wi-Fi)"
            help
                Both boards must be on the same Wi-Fi channel: joined to the
                same network, or one joined to the network the other hosts.
                Wi-Fi is switched on for this even if the web console is off.

        config MOCK_LINK_UART
            bool "UART (three wires between the boards)"
            help
                Board A's TX pin to board B's RX pin, B's TX to A's RX, and
                ground to ground. The most even in timing, and it leaves the
                radio to the web console.

        config MOCK_LINK_NONE
            bool "None (the link route is not available)"
    endchoice

    config MOCK_LINK_UART_TX_GPIO
        int "UART link: TX pin (GPIO)"
        range 0 48
        default 17
        depends on MOCK_LINK_UART
        help
            Not 19/20 (USB), 35-37 (octal PSRAM), 43/44 (the console UART)
            or the LED's pin.

    config MOCK_LINK_UART_RX_GPIO
        int "UART link: RX pin (GPIO)"
        range 0 48
        default 18
        depends on MOCK_LINK_UART

    config MOCK_LINK_UART_BAUD
        int "UART link: bits per second"
        range 460800 3000000
        default 921600
        depends on MOCK_LINK_UART
        help
            The audio needs about 250 000. The same on both boards.

endmenu
```

## components/web_console/Kconfig
```kconfig
menu "Mock radio: web console"

    config MOCK_WEB_CONSOLE
        bool "Web console over Wi-Fi"
        default y
        help
            A page to change the mock's settings and watch what it is doing,
            reached over Wi-Fi while a modem application holds the CAT port.
            It uses no USB endpoint. With this off and the two-board link
            not on ESP-NOW, the 2.4 GHz radio stays silent, for example while
            judging USB audio on its own.

endmenu
```

## components/wifi_net/Kconfig
```kconfig
# Wi-Fi is on when something in the build needs it.
config MOCK_WIFI
    bool
    default y if MOCK_WEB_CONSOLE || MOCK_LINK_ESPNOW
    default n

menu "Mock radio: Wi-Fi"
    depends on MOCK_WIFI

    comment "Used by the web console and by the ESP-NOW link, which share the one radio."

    config MOCK_WIFI_SSID
        string "Wi-Fi network to join (SSID)"
        default ""
        help
            The network the board joins at start-up. Empty: it hosts its own
            network. A network saved from the console's Wi-Fi form is used
            instead of this one. This value ends up in sdkconfig, which is
            not committed; do not put it in sdkconfig.defaults.

    config MOCK_WIFI_PASSWORD
        string "Wi-Fi password"
        default ""

    config MOCK_WIFI_JOIN_TIMEOUT_S
        int "Seconds to wait for the network before hosting one"
        range 5 120
        default 20
        help
            If the board has not joined its network in this time after
            start-up, it hosts its own until the next restart.

    config MOCK_WIFI_AP_PASSWORD
        string "Password of the board's own network"
        default "mockradio"
        help
            WPA2, 8 to 63 characters. Empty, or shorter than 8, makes the
            network open. The network is named after the board:
            mockradio-xxxx, from its MAC address. The console is at
            http://192.168.4.1/ on it.

    config MOCK_WIFI_AP_CHANNEL
        int "Channel of the board's own network"
        range 1 11
        default 1
        help
            The ESP-NOW link uses whatever channel Wi-Fi is on, and two
            linked boards must be on the same one: both joined to the same
            network, or one joined to the network the other hosts.

endmenu
```

## main/Kconfig.projbuild
```kconfig
menu "Mock radio: the radio imitated"

    choice MOCK_RIG
        prompt "Radio at first start"
        default MOCK_RIG_IC705
        help
            The radio the board imitates until it is told otherwise. The
            choice is changed at run time with host/tools/mockctl.py (rig=)
            or in the web console, and the board remembers it in flash: a
            board that has been told keeps its radio through a restart and
            through flashing new firmware, whatever is chosen here.

        config MOCK_RIG_IC705
            bool "Icom IC-705 (Hamlib model 3085)"
        config MOCK_RIG_G90
            bool "Xiegu G90 (Hamlib model 3088)"
    endchoice

endmenu

menu "Mock radio: receive route and channel at power-up"

    comment "Power-up values. Change them at run time with host/tools/mockctl.py."

    choice MOCK_ROUTE
        prompt "Receive route"
        default MOCK_ROUTE_MONITOR
        help
            Monitor: audio the host plays comes straight back, whatever PTT
            does. Radio: receive is muted while keyed and for the turnaround
            time after, and there is nothing to hear but the noise floor.
            Parrot: like radio, and each transmission is recorded and played
            back after it.

        config MOCK_ROUTE_MONITOR
            bool "Monitor (loopback, PTT ignored)"
        config MOCK_ROUTE_RADIO
            bool "Radio (mute while keyed, no signal)"
        config MOCK_ROUTE_PARROT
            bool "Parrot (record while keyed, replay after)"
        config MOCK_ROUTE_LINK
            bool "Link (hear a second board, and be heard by it)"
            depends on !MOCK_LINK_NONE
    endchoice

    config MOCK_NOISE_ON
        bool "Add noise and hold the signal at a set SNR"
        default y
        help
            On, receive audio has a noise floor and the signal is held at the
            SNR below it, as from a radio. Off, it is exact: silence between
            signals, and the monitor route a bit-exact loopback (what
            host/tools/audio_loopcheck.swift needs). Modems such as Data2G
            show a black waterfall and warn of clipping with it off.

    config MOCK_SNR_DB
        int "SNR in dB"
        range -60 80
        default 10
        depends on MOCK_NOISE_ON

    config MOCK_SNR_REF_BW_HZ
        int "Bandwidth the SNR is quoted in, Hz"
        range 100 24000
        default 2500
        depends on MOCK_NOISE_ON
        help
            2500 for WSJT-X and Data2G, 3000 for VARA and most channel simulators.

    config MOCK_NOISE_FLOOR_DBFS
        int "Noise floor in dBFS (RMS over the whole audio band)"
        range -90 -12
        default -40
        depends on MOCK_NOISE_ON

    config MOCK_ATTEN_DB
        int "Extra attenuation in dB"
        range 0 120
        default 0

    config MOCK_FADE
        int "Fading: 0 off, 1 mpg, 2 mpp, 3 mpd, 4 mps, 5 nvis-d, 6 lowlat-d, 7 hilat-m, 8 hilat-d"
        range 0 8
        default 0
        help
            What an HF path does to the signal: two paths that fade apart.
            mpg is a good path (0.1 Hz of Doppler spread, 0.5 ms between the
            paths), mpp a poor one (1 Hz, 2 ms), mpd a disturbed one (2 Hz,
            4 ms), mps slow and selective (0.15 Hz, 2 ms). The last four are
            severe conditions from ITU-R F.1487. The names are the Data2G
            project's. Other numbers can be set at run time (fade=custom).

    config MOCK_TURNAROUND_MS
        int "Receive mute after unkeying, ms"
        range 0 5000
        default 30
        help
            Applies in the radio and parrot routes.

    config MOCK_PARROT_SECONDS
        int "Parrot buffer, seconds"
        range 5 300
        default 120
        help
            The longest transmission the parrot can hold, allocated in PSRAM
            at start-up whatever the route: 24 KB per second (12 kHz, 16-bit
            mono). 120 s covers every WSJT-X mode up to WSPR. Build-time only.

    config MOCK_PARROT_DELAY_MS
        int "Parrot: delay from unkeying to the replay, ms"
        range 0 60000
        default 1000
        help
            The replay never starts sooner than 50 ms after unkeying.

    config MOCK_PARROT_PERIOD_MS
        int "Parrot: slot period, ms (0 = off)"
        range 0 300000
        default 0
        help
            If set, the replay waits for a whole number of periods after
            key-on, so it lands at the same place in a later time slot: 15000
            for FT8, 7500 for FT4. A program that transmits in every other
            slot then hears itself in the slot between.

    config MOCK_LINK_BUFFER_MS
        int "Link: audio held before it is played, ms"
        range 10 200
        default 80
        depends on !MOCK_LINK_NONE
        help
            More rides out uneven arrival from the other board; less makes
            the path quicker, which ARQ turnarounds like. ESP-NOW sharing
            the radio with Wi-Fi delivers packets in bunches: on the bench
            30 ms ran dry every few seconds and 80 ms never did.

    config MOCK_LINK_MATCH
        bool "Link: hear the other board only on the same frequency"
        default y
        depends on !MOCK_LINK_NONE

    config MOCK_LINK_SHARE
        bool "Link: the two boards share one channel"
        default y
        depends on !MOCK_LINK_NONE
        help
            Noise, SNR, attenuation and fading are then the pair's: set on
            either board, they apply to both, and the two directions fade
            alike. Off, each board has its own, and the path can differ
            between the two directions.

endmenu

menu "Mock radio: PTT sources at power-up"

    comment "CAT keying (1C 00) always works. These add to it."

    choice MOCK_PTT_LINE
        prompt "Serial control line that keys the radio"
        default MOCK_PTT_LINE_OFF
        help
            Hosts raise DTR and RTS when they open the serial port and leave
            them high unless one is their PTT line, so select a line only for
            software that keys with it.

        config MOCK_PTT_LINE_OFF
            bool "None"
        config MOCK_PTT_LINE_RTS
            bool "RTS"
        config MOCK_PTT_LINE_DTR
            bool "DTR"
    endchoice

    config MOCK_VOX
        bool "VOX: transmit audio keys the radio"
        default n

    config MOCK_VOX_THRESHOLD_DBFS
        int "VOX threshold in dBFS"
        range -80 -6
        default -40
        help
            A transmit sample this large opens the VOX.

    config MOCK_VOX_HANG_MS
        int "VOX hang time, ms"
        range 0 5000
        default 100
        help
            The VOX stays open this long after the last sample over the
            threshold.

endmenu

menu "Mock radio: status LED"

    config MOCK_LED
        bool "Show the radio's state on the board's RGB LED"
        default y
        help
            Dim white: no USB host. Dim blue: receiving. Red: transmitting
            (recording, in the parrot route). Amber: the parrot is waiting
            to replay. Green: the parrot is replaying, or the other board
            is being heard over the link.

    config MOCK_LED_GPIO
        int "GPIO of the RGB LED"
        range 0 48
        default 48
        depends on MOCK_LED
        help
            48 on the ESP32-S3-DevKitC-1 v1.0 and most clones, 38 on v1.1.
            On some clones the "RGB" solder pad must be bridged first. Not
            35-37 (octal PSRAM) or 19/20 (USB).

    config MOCK_LED_BRIGHTNESS
        int "Brightness, percent"
        range 1 100
        default 10
        depends on MOCK_LED

endmenu

menu "Mock radio: board health"

    config MOCK_HEALTH_LOG_S
        int "Log the board's health every this many seconds (0 = never)"
        range 0 3600
        default 30
        help
            A few lines in the log on the COM jack: free memory, how busy
            each processor core is and how long the audio work takes. The
            web console shows the same and more; this is for a build without
            it, and for a record of a long run.

    config MOCK_HEALTH_LOG_TASKS
        bool "List the tasks in the log too"
        default n
        depends on MOCK_HEALTH_LOG_S > 0
        help
            Each task's stack headroom and share of a processor core. Reading
            them holds the whole board up for a millisecond or so each time,
            which can disturb USB audio: leave this off while judging audio.
            The web console reads the same table when its button is pressed.

endmenu
```
